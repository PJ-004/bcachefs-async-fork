## drivers/ec_offload/Kconfig
```kconfig
config EC_OFFLOAD
    tristate "Mock Erasure Coding offload device"
    help
      Provides a mock erasure coding accelerator driver
      for testing async EC paths in filesystems.
```
